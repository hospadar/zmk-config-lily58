/{
    &left_encoder {
           steps = <18>
    }

    right_encoder: encoder_right {
        compatible = "alps,ec11";
        a-gpios = <&pro_micro 20 (GPIO_ACTIVE_HIGH | GPIO_PULL_UP)>;
        b-gpios = <&pro_micro 21 (GPIO_ACTIVE_HIGH | GPIO_PULL_UP)>;
        steps = <18>;
        status = "ok";
    };

    &sensors{
        compatible = "zmk,keymap-sensors";
        sensors = <&left_encoder &right_encoder>;
        triggers-per-rotation = <18>;
    };

    &nice_view_spi {
        cs-gpios = <&pro_micro 4 GPIO_ACTIVE_HIGH>;
    }
}